## config/west.yml
```yaml
manifest:
  remotes:
    - name: zmkfirmware
      url-base: https://github.com/zmkfirmware
    - name: kyria
      url-base: https://github.com/petejohanson
  projects:
    - name: zmk
      remote: kyria
      revision: shields/kyria-rev3
      import: app/west.yml
  self:
    path: config
```
